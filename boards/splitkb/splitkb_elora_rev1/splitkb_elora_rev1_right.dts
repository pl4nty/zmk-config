/*
 * Copyright (c) 2026 The ZMK Contributors
 *
 * SPDX-License-Identifier: MIT
 */

#include "splitkb_elora_rev1.dtsi"

&right_encoder1 { status = "okay"; };
&right_encoder2 { status = "okay"; };
&right_encoder3 { status = "okay"; };

&default_transform {
    row-offset = <6>;
};
