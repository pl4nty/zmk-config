## boards/splitkb/splitkb_elora_rev1/Kconfig.defconfig
```kconfig
# SPDX-License-Identifier: MIT

if BOARD_SPLITKB_ELORA_REV1_LEFT

config ZMK_KEYBOARD_NAME
    default "Elora"

config ZMK_SPLIT_ROLE_CENTRAL
    default y

endif # BOARD_SPLITKB_ELORA_REV1_LEFT

if BOARD_SPLITKB_ELORA_REV1_LEFT || BOARD_SPLITKB_ELORA_REV1_RIGHT

config ZMK_SPLIT
    default y

config USB_SELF_POWERED
    default n

endif # BOARD_SPLITKB_ELORA_REV1_LEFT || BOARD_SPLITKB_ELORA_REV1_RIGHT
```

## boards/splitkb/splitkb_elora_rev1/Kconfig.splitkb_elora_rev1_left
```kconfig
# SPDX-License-Identifier: MIT

config BOARD_SPLITKB_ELORA_REV1_LEFT
    select SOC_RP2040
    select RP2_FLASH_W25Q080
    select ZMK_BOARD_COMPAT
```

## boards/splitkb/splitkb_elora_rev1/Kconfig.splitkb_elora_rev1_right
```kconfig
# SPDX-License-Identifier: MIT

config BOARD_SPLITKB_ELORA_REV1_RIGHT
    select SOC_RP2040
    select RP2_FLASH_W25Q080
    select ZMK_BOARD_COMPAT
```

## boards/splitkb/splitkb_elora_rev1/board.yml
```yaml
boards:
  - name: splitkb_elora_rev1_left
    full_name: Elora rev1 (left)
    vendor: splitkb
    socs:
      - name: rp2040
  - name: splitkb_elora_rev1_right
    full_name: Elora rev1 (right)
    vendor: splitkb
    socs:
      - name: rp2040
```

## drivers/kscan/Kconfig
```kconfig
# SPDX-License-Identifier: MIT

config ZMK_KSCAN_74HC165
    bool "74HC165 shift register kscan driver"
    default y
    depends on DT_HAS_ZMK_KSCAN_74HC165_ENABLED
    select SPI
    help
      Polls a chain of 74HC165 parallel-in/serial-out shift registers over SPI
      and reports each input bit as a key.

config ZMK_KSCAN_74HC165_ENCODER
    bool "Rotary encoders read through a 74HC165 kscan"
    default y
    depends on ZMK_KSCAN_74HC165
    depends on DT_HAS_ZMK_KSCAN_74HC165_ENCODER_ENABLED
    select SENSOR
```

## dts/bindings/kscan/zmk,kscan-74hc165.yaml
```yaml
# SPDX-License-Identifier: MIT

description: |
  Key scanner for a chain of 74HC165 parallel-in/serial-out shift registers,
  read over SPI. Byte N of the transfer is reported as row N, and bit M of
  that byte (bit 0 = least significant) as column M.

  The chip select line must latch the registers: inactive loads the parallel
  inputs, active shifts them out.

compatible: "zmk,kscan-74hc165"

include: [kscan.yaml, spi-device.yaml]

properties:
  num-bytes:
    type: int
    required: true
    description: Number of chained shift registers (bytes read per scan).

  active-low:
    type: boolean
    description: Inputs read 0 when the switch is closed (pull-ups to VCC).

  poll-period-ms:
    type: int
    default: 1
    description: Time between scans.

  debounce-press-ms:
    type: int
    default: 5
    description: Time a press must be stable before it is reported.

  debounce-release-ms:
    type: int
    default: 5
    description: Time a release must be stable before it is reported.
```

## dts/bindings/sensor/zmk,kscan-74hc165-encoder.yaml
```yaml
# SPDX-License-Identifier: MIT

description: |
  Quadrature rotary encoder whose A and B pins are inputs of a
  zmk,kscan-74hc165 shift register chain. Bits are numbered
  row * 8 + column, using the kscan's row/column numbering.
  These bits are not reported as keys.

compatible: "zmk,kscan-74hc165-encoder"

properties:
  kscan:
    type: phandle
    required: true
    description: The zmk,kscan-74hc165 node the encoder is wired to.

  a-bit:
    type: int
    required: true

  b-bit:
    type: int
    required: true

  steps:
    type: int
    required: true
    description: Quadrature transitions per full rotation.
```
