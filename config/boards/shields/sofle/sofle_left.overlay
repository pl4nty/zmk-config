/*
 * Copyright (c) 2020 Ryan Cross
 *
 * SPDX-License-Identifier: MIT
 e6 7 b5 9
 */

#include "sofle.dtsi"

&kscan0 {
	col-gpios
		= <&pro_micro_a  1 GPIO_ACTIVE_HIGH>
		, <&pro_micro_a  0 GPIO_ACTIVE_HIGH>
		, <&pro_micro_d 15 GPIO_ACTIVE_HIGH>
		, <&pro_micro_d 14 GPIO_ACTIVE_HIGH>
		, <&pro_micro_d 16 GPIO_ACTIVE_HIGH>
		, <&pro_micro_d 10 GPIO_ACTIVE_HIGH>
		;
    row-gpios
        = <&pro_micro_d 5 (GPIO_ACTIVE_HIGH | GPIO_PULL_DOWN)>
        , <&pro_micro_d 6 (GPIO_ACTIVE_HIGH | GPIO_PULL_DOWN)>
        , <&pro_micro_d 3 (GPIO_ACTIVE_HIGH | GPIO_PULL_DOWN)>
        , <&pro_micro_d 8 (GPIO_ACTIVE_HIGH | GPIO_PULL_DOWN)>
        , <&pro_micro_d 4 (GPIO_ACTIVE_HIGH | GPIO_PULL_DOWN)>
        ;
};

&left_encoder {
	status = "okay";
};